# file: F0_RTC_Print.ioc
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Mcu.Family=STM32F0
Mcu.Name=STM32F051R8Tx
Mcu.Package=LQFP64
ProjectManager.HeapSize=0x200
ProjectManager.StackSize=0x400
ProjectManager.TargetToolchain=STM32CubeIDE
VP_RTC_VS_RTC_Activate.Mode=RTC_Enabled
board=custom

// file: Core/Src/main.c
/* USER CODE BEGIN Header */
/**
  ******************************************************************************
  * @file           : main.c
  * @brief          : Main program body
  ******************************************************************************
  * @attention
  *
  * Copyright (c) 2023 STMicroelectronics.
  * All rights reserved.
  *
  * This software is licensed under terms that can be found in the LICENSE file
  * in the root directory of this software component.
  * If no LICENSE file comes with this software, it is provided AS-IS.
  *
  ******************************************************************************
  */
/* USER CODE END Header */
#include "main.h"

/* USER CODE BEGIN Includes */
#include <stdio.h>
#include <string.h>
/* USER CODE END Includes */

/* USER CODE BEGIN PTD */
char time[30];
RTC_TimeTypeDef sTime;
/* USER CODE END PTD */

RTC_HandleTypeDef hrtc;

void SystemClock_Config(void);
static void MX_RTC_Init(void);

int main(void)
{

  /* MCU Configuration--------------------------------------------------------*/

  /* Reset of all peripherals, Initializes the Flash interface and the Systick. */
  HAL_Init();

  /* Configure the system clock */
  SystemClock_Config();

  /* Initialize all configured peripherals */
  MX_RTC_Init();

  /* Infinite loop */
  while (1)
  {

    /* USER CODE BEGIN 3 */
	  sprintf(time,"Current Time: %02d.%02d.%02d\r\n",sTime.Hours,sTime.Minutes,sTime.Seconds);
	  HAL_UART_Transmit(&huart3, (uint8_t *)time, sizeof(time), 300);
	  HAL_Delay(1000);
  }

  static void MX_RTC_Void(void) {
	  /* USER CODE BEGIN RTC_Init 0 */

	      /* USER CODE END RTC_Init 0 */

	      RTC_TimeTypeDef sTime = {0};

	      /* USER CODE BEGIN RTC_Init 1 */

	      /* USER CODE END RTC_Init 1 */
	      /** Initialize RTC Only
	      */
	      hrtc.Instance = USART3;
	      hrtc.Init.HourFormat = RTC_HOURFORMAT_24;
	      hrtc.Init.AsynchPrediv = 127;
	      hrtc.Init.SynchPrediv = 255;
	      hrtc.Init.OutPut = RTC_OUTPUT_DISABLE;
	      hrtc.Init.OutPutPolarity = RTC_OUTPUT_POLARITY_HIGH;
	      hrtc.Init.OutPutType = RTC_OUTPUT_TYPE_OPENDRAIN;
	      if (HAL_RTC_Init(&hrtc) != HAL_OK)
	      {
	          Error_Handler();
	      }

	      /* USER CODE BEGIN Check_RTC_BKUP */

	      /* USER CODE END Check_RTC_BKUP */

	      /** Initialize RTC and set the Time and Date
	      */
	      sTime.Hours = 0x10;
	      sTime.Minutes = 0x20;
	      sTime.Seconds = 0x30;
	      sTime.Milliseconds = 0x40;
	      sTime.DayLightSaving = RTC_DAYLIGHTSAVING_NONE;
	      sTime.StoreOperation = RTC_STOREOPERATION_RESET;
	      if (HAL_RTC_SetTime(&hrtc, &sTime, RTC_FORMAT_BCD) != HAL_OK)
	      {
	          Error_Handler();
	      }
	      /* USER CODE BEGIN RTC_Init 2 */

	      /* USER CODE END RTC_Init 2 */

  }
  /* USER CODE END 3 */
}

void SystemClock_Config(void)
{
  RCC_OscInitTypeDef RCC_OscInitStruct = {0};
  RCC_ClkInitTypeDef RCC_ClkInitStruct = {0};
  RCC_PeriphCLKInitTypeDef PeriphClkInit = {0};

  /** Initializes the RCC Oscillators according to the specified parameters
  * in the RCC_OscInitTypeDef structure.
  */
  RCC_OscInitStruct.OscillatorType = RCC_OSCILLATORTYPE_HSI|RCC_OSCILLATORTYPE_LSI;
  RCC_OscInitStruct.HSIState = RCC_HSI_ON;
  RCC_OscInitStruct.HSICalibrationValue = RCC_HSICALIBRATION_DEFAULT;
  RCC_OscInitStruct.LSIState = RCC_LSI_ON;
  RCC_OscInitStruct.PLL.PLLState = RCC_PLL_NONE;
  if (HAL_RCC_OscConfig(&RCC_OscInitStruct) != HAL_OK)
  {
    Error_Handler();
  }

  /** Initializes the CPU, AHB and APB buses clocks
  */
  RCC_ClkInitStruct.ClockType = RCC_CLOCKTYPE_HCLK|RCC_CLOCKTYPE_SYSCLK
                              |RCC_CLOCKTYPE_PCLK1;
  RCC_ClkInitStruct.SYSCLKSource = RCC_SYSCLKSOURCE_HSI;
  RCC_ClkInitStruct.AHBCLKDivider = RCC_SYSCLK_DIV1;
  RCC_ClkInitStruct.APB1CLKDivider = RCC_HCLK_DIV1;

  if (HAL_RCC_ClockConfig(&RCC_ClkInitStruct, FLASH_LATENCY_0) != HAL_OK)
  {
    Error_Handler();
  }
  PeriphClkInit.PeriphClockSelection = RCC_PERIPHCLK_RTC;
  PeriphClkInit.RTCClockSelection = RCC_RTCCLKSOURCE_LSI;
  if (HAL_RCCEx_PeriphCLKConfig(&PeriphClkInit) != HAL_OK)
  {
    Error_Handler();
  }
}

static void MX_RTC_Init(void)
{

  /** Initialize RTC Only
  */
  hrtc.Instance = RTC;
  hrtc.Init.HourFormat = RTC_HOURFORMAT_24;
  hrtc.Init.AsynchPrediv = 127;
  hrtc.Init.SynchPrediv = 255;
  hrtc.Init.OutPut = RTC_OUTPUT_DISABLE;
  hrtc.Init.OutPutPolarity = RTC_OUTPUT_POLARITY_HIGH;
  hrtc.Init.OutPutType = RTC_OUTPUT_TYPE_OPENDRAIN;
  if (HAL_RTC_Init(&hrtc) != HAL_OK)
  {
    Error_Handler();
  }

}

void Error_Handler(void)
{
  __disable_irq();
  while (1)
  {
  }
}
